## esp-src/main/Kconfig.projbuild
```kconfig
menu "Wi-Fi EasyConnect Settings"
	config ESP_DPP_BOOTSTRAPPING_KEY
		string "Bootstrapping key"
		help
			64 hex digits (or 32 bytes) of raw private key for DPP Bootstrapping
endmenu
```
